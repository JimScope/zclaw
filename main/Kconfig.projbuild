## main/Kconfig.projbuild
```kconfig
menu "zclaw Configuration"

    config ZCLAW_WIFI_SSID
        string "WiFi SSID (for testing only)"
        default ""
        help
            WiFi network name fallback. Leave empty to use NVS provisioning.
            Recommended: run ./scripts/provision.sh after flashing.

    config ZCLAW_WIFI_PASSWORD
        string "WiFi Password (for testing only)"
        default ""
        help
            WiFi network password fallback. Leave empty to use NVS provisioning.

    config ZCLAW_CLAUDE_API_KEY
        string "LLM API Key (for testing only)"
        default ""
        help
            Anthropic API key fallback. Leave empty to use NVS provisioning.

    config ZCLAW_ALLOW_UNENCRYPTED_NVS_FALLBACK
        bool "Allow unencrypted NVS fallback when flash encryption is enabled (dev only)"
        default n
        help
            If disabled (recommended), firmware startup fails when encrypted NVS
            initialization fails under active flash encryption.
            Enable only for explicit local debug scenarios.

    config ZCLAW_STUB_LLM
        bool "Stub LLM responses (for QEMU testing)"
        default n
        help
            When enabled, returns hardcoded responses instead of calling the LLM API.
            Useful for testing without WiFi (QEMU emulator).

    config ZCLAW_STUB_TELEGRAM
        bool "Stub Telegram (for QEMU testing)"
        default n
        help
            When enabled, skips Telegram initialization.
            Useful for testing without WiFi.

    config ZCLAW_CHANNEL_UART
        bool "Use UART0 for local channel (QEMU-friendly)"
        default y if !SOC_USB_SERIAL_JTAG_SUPPORTED
        default n
        help
            Uses UART0 instead of USB Serial/JTAG for local input/output.
            Enable this for interactive QEMU use.
            Targets without USB Serial/JTAG default to UART automatically.

    config ZCLAW_EMULATOR_MODE
        bool "Offline emulator mode (skip WiFi/NTP/Telegram startup)"
        default n
        help
            Starts only local channel + agent loop, without WiFi-dependent startup.
            Intended for QEMU development workflows.

    config ZCLAW_EMULATOR_LIVE_LLM
        bool "Host-bridged live LLM in emulator mode"
        default n
        help
            Routes LLM requests over UART to a host-side bridge process so QEMU can
            use real provider APIs without guest WiFi/TLS networking.
            Intended for emulator testing only.

    menu "GPIO Tool Safety"
        config ZCLAW_GPIO_MIN_PIN
            int "Minimum GPIO pin exposed to tools"
            range 0 48
            default 2
            help
                Lower bound for gpio_write/gpio_read tool access.
                Set this to match safe, wired pins on your board.

        config ZCLAW_GPIO_MAX_PIN
            int "Maximum GPIO pin exposed to tools"
            range 0 48
            default 10
            help
                Upper bound for gpio_write/gpio_read tool access.
                Set this to match safe, wired pins on your board.

        config ZCLAW_GPIO_ALLOWED_PINS
            string "Allowed GPIO pins list (optional)"
            default ""
            help
                Optional comma-separated allowlist for gpio_write/gpio_read.
                Example: "1,2,3,4,5,6,7,8,9,43,44"
                When set (non-empty), this list is used instead of min/max range.

        config ZCLAW_BOARD_RESERVED_GPIOS
            string "GPIOs reserved by the board (comma-separated)"
            default "3" if IDF_TARGET_ESP32C6
            default ""
            help
                Pins the board itself uses. On some ESP32-C6 boards GPIO3
                powers the RF switch: driving it high disconnects the antenna
                and WiFi sees no networks. GPIO tools refuse these pins and the
                display/SD bus refuses to start on them.
    endmenu

    config ZCLAW_WIFI_FALLBACK_SSID
        string "Fallback WiFi SSID (optional)"
        default ""
        help
            Secondary network tried when the primary WiFi is unreachable,
            both at boot and after runtime disconnections (e.g. a phone
            hotspot that survives power outages). Empty disables fallback.

    config ZCLAW_WIFI_FALLBACK_PASSWORD
        string "Fallback WiFi password"
        default ""

    config ZCLAW_VENDEL_URL
        string "Vendel SMS gateway send endpoint"
        default "https://app.vendel.cc/api/sms/send"
        help
            POST endpoint of the Vendel SMS gateway used by the sms_send tool.

    config ZCLAW_VENDEL_API_KEY
        string "Vendel SMS gateway API key"
        default ""
        help
            X-API-Key value for the Vendel SMS gateway. Leave empty to
            disable the sms_send tool at runtime.

    config ZCLAW_LED_STRIP_GPIO
        int "Onboard addressable RGB LED (WS2812) GPIO"
        range 0 48
        default 8
        help
            Data pin of the onboard WS2812/NeoPixel LED used by the
            led_set/led_blink tools. Most ESP32-C6 devkits use GPIO 8.

    menu "Display and SD card"
        config ZCLAW_DISPLAY_ENABLE
            bool "Enable ST7789 240x240 SPI display"
            default n
            help
                Animated face (frames from the SD card) alternating with a
                status page. Shares SPI2 with the SD card.

        config ZCLAW_SD_ENABLE
            bool "Enable SD card (FAT) on the shared SPI bus"
            default n

        config ZCLAW_SPI_SCLK_GPIO
            int "Shared SPI SCLK GPIO"
            range 0 48
            default 6
            depends on ZCLAW_DISPLAY_ENABLE || ZCLAW_SD_ENABLE

        config ZCLAW_SPI_MOSI_GPIO
            int "Shared SPI MOSI GPIO"
            range 0 48
            default 5
            depends on ZCLAW_DISPLAY_ENABLE || ZCLAW_SD_ENABLE

        config ZCLAW_SPI_MISO_GPIO
            int "Shared SPI MISO GPIO (SD card only)"
            range 0 48
            default 2
            depends on ZCLAW_SD_ENABLE

        config ZCLAW_DISPLAY_CS_GPIO
            int "Display CS GPIO"
            range 0 48
            default 7
            depends on ZCLAW_DISPLAY_ENABLE

        config ZCLAW_DISPLAY_DC_GPIO
            int "Display DC GPIO"
            range 0 48
            default 1
            depends on ZCLAW_DISPLAY_ENABLE

        config ZCLAW_DISPLAY_RST_GPIO
            int "Display reset GPIO"
            range 0 48
            default 0
            depends on ZCLAW_DISPLAY_ENABLE

        config ZCLAW_DISPLAY_BL_GPIO
            int "Display backlight GPIO (PWM)"
            range 0 48
            default 10
            depends on ZCLAW_DISPLAY_ENABLE

        config ZCLAW_DISPLAY_INVERT_COLORS
            bool "Invert display colours (most IPS ST7789 modules need this)"
            default y
            depends on ZCLAW_DISPLAY_ENABLE

        config ZCLAW_DISPLAY_X_GAP
            int "Display column offset"
            range 0 80
            default 0
            depends on ZCLAW_DISPLAY_ENABLE

        config ZCLAW_DISPLAY_Y_GAP
            int "Display row offset"
            range 0 80
            default 0
            depends on ZCLAW_DISPLAY_ENABLE

        config ZCLAW_DISPLAY_BRIGHTNESS
            int "Backlight brightness (%)"
            range 0 100
            default 80
            depends on ZCLAW_DISPLAY_ENABLE

        config ZCLAW_FACE_SECONDS
            int "Seconds on the face page"
            range 1 600
            default 10
            depends on ZCLAW_DISPLAY_ENABLE

        config ZCLAW_STATUS_SECONDS
            int "Seconds on the status page in the rotation (0 = only on /panel)"
            range 0 600
            default 0
            depends on ZCLAW_DISPLAY_ENABLE

        config ZCLAW_SD_CS_GPIO
            int "SD card CS GPIO"
            range 0 48
            default 18
            depends on ZCLAW_SD_ENABLE
    endmenu

    menu "Factory Reset"
        config ZCLAW_FACTORY_RESET_PIN
            int "Factory reset button GPIO"
            range 0 48
            default 9
            help
                Hold this pin low during startup for the configured hold time
                to erase NVS settings and restart.
                Set this to your board's wired reset/config button GPIO.

        config ZCLAW_FACTORY_RESET_HOLD_MS
            int "Factory reset hold time (ms)"
            range 1000 60000
            default 5000
            help
                Duration the reset pin must stay low to trigger factory reset.
    endmenu

endmenu
```
